    {NOTE_C5, 375},
    {NOTE_B4, 125},
    {NOTE_C5, 375},
    {NOTE_B4, 125},
    {NOTE_C5, 500},
    {NOTE_G4, 500},
    {NOTE_A4, 500},
    {NOTE_C5, 375},
    {NOTE_DS5, 125},
    {NOTE_D5, 375},
    {NOTE_C5, 125},
    {NOTE_REST, 500},
    {NOTE_C5, 375},
    {NOTE_B4, 125},
    {NOTE_C5, 375},
    {NOTE_B4, 125},
    {NOTE_C5, 500},
    {NOTE_GS4, 375},
    {NOTE_G4, 500},
    {NOTE_G5, 125},
    {NOTE_G4, 375},
    {NOTE_FS5, 125},
    {NOTE_G4, 500},
    {NOTE_REST, 500},
    {NOTE_C5, 375},
    {NOTE_B4, 125},
    {NOTE_C5, 375},
    {NOTE_B4, 125},
    {NOTE_C5, 500},
    {NOTE_G4, 500},
    {NOTE_A4, 500},
    {NOTE_C5, 375},
    {NOTE_DS5, 125},
    {NOTE_D5, 375},
    {NOTE_C5, 125},
    {NOTE_D5, 500},
    {NOTE_C5, 375},
    {NOTE_B4, 125},
    {NOTE_C5, 375},
    {NOTE_B4, 125},
    {NOTE_C5, 500},
    {NOTE_REST, 375},
    {NOTE_D5, 500},
    {NOTE_G5, 125},
    {NOTE_REST, 375},
    {NOTE_FS5, 125},
    {NOTE_G5, 500},
    {NOTE_REST, 500},
    {NOTE_E5, 375},
    {NOTE_DS5, 125},
    {NOTE_E5, 375},
    {NOTE_DS5, 125},
    {NOTE_E5, 500},
    {NOTE_G5, 375},
    {NOTE_F5, 125},
    {NOTE_REST, 375},
    {NOTE_F5, 125},
    {NOTE_REST, 375},
    {NOTE_E5, 125},
    {NOTE_F5, 500},
    {NOTE_REST, 500},
    {NOTE_CS5, 375},
    {NOTE_C5, 125},
    {NOTE_CS5, 375},
    {NOTE_C5, 125},
    {NOTE_AS4, 500},
    {NOTE_REST, 375},
    {NOTE_CS5, 125},
    {NOTE_REST, 375},
    {NOTE_AS4, 125},
    {NOTE_REST, 375},
    {NOTE_CS6, 125},
    {NOTE_REST, 375},
    {NOTE_AS5, 125},
    {NOTE_REST, 500},
    {NOTE_C5, 375},
    {NOTE_B4, 125},
    {NOTE_C5, 375},
    {NOTE_B4, 125},
    {NOTE_A4, 500},
    {NOTE_REST, 375},
    {NOTE_C5, 125},
    {NOTE_REST, 375},
    {NOTE_A4, 125},
    {NOTE_REST, 375},
    {NOTE_C6, 125},
    {NOTE_REST, 375},
    {NOTE_A5, 125},
    {NOTE_REST, 500},
    {NOTE_A4, 375},
    {NOTE_F4, 125},
    {NOTE_REST, 500},
    {NOTE_B4, 375},
    {NOTE_G4, 125},
    {NOTE_REST, 500},
    {NOTE_C5, 375},
    {NOTE_A4, 125},
    {NOTE_REST, 375},
    {NOTE_D5, 125},
    {NOTE_REST, 1000},
    {NOTE_G4, 500},
    {NOTE_D5, 1000},
    {NOTE_REST, 500},
    {NOTE_D5, 500},
    {NOTE_C5, 500},
    {NOTE_REST, 500},
    {NOTE_C5, 1000},
    {NOTE_B4, 500},
    {NOTE_REST, 1000},
    {NOTE_B4, 500},
    {NOTE_G4, 500},
    {NOTE_REST, 1000},
    {NOTE_G4, 1000},
    {NOTE_A4, 375},
    {NOTE_G4, 125},
    {NOTE_F4, 375},
    {NOTE_G4, 500},
    {NOTE_G5, 125},
    {NOTE_REST, 500},
    {NOTE_G5, 500},
    {NOTE_REST, 500},
    {NOTE_GS4, 1000},
    {NOTE_AS4, 375},
    {NOTE_GS4, 125},
    {NOTE_F4, 375},
    {NOTE_GS4, 500},
    {NOTE_GS5, 125},
    {NOTE_REST, 500},
    {NOTE_AS5, 375},
    {NOTE_GS5, 125},
    {NOTE_F5, 500},
    {NOTE_A4, 1000},
    {NOTE_B4, 375},
    {NOTE_A4, 125},
    {NOTE_G4, 375},
    {NOTE_A4, 500},
    {NOTE_A5, 125},
    {NOTE_REST, 500},
    {NOTE_B5, 375},
    {NOTE_A5, 125},
    {NOTE_G5, 500},
    {NOTE_AS4, 2000},
    {NOTE_G4, 375},
    {NOTE_GS4, 125},
    {NOTE_A4, 375},
    {NOTE_B4, 125},
    {NOTE_REST, 1000},
    {NOTE_C5, 375},
    {NOTE_B4, 125},
    {NOTE_C5, 375},
    {NOTE_B4, 125},
    {NOTE_C5, 500},
    {NOTE_G4, 500},
    {NOTE_A4, 500},
    {NOTE_C5, 375},
    {NOTE_DS5, 125},
    {NOTE_D5, 375},
    {NOTE_C5, 125},
    {NOTE_D5, 500},
    {NOTE_C5, 375},
    {NOTE_B4, 125},
    {NOTE_C5, 375},
    {NOTE_B4, 125},
    {NOTE_C5, 500},
    {NOTE_GS4, 375},
    {NOTE_G4, 500},
    {NOTE_G5, 125},
    {NOTE_REST, 375},
    {NOTE_FS5, 125},
    {NOTE_G5, 500},
    {NOTE_REST, 500},
    {NOTE_C5, 375},
    {NOTE_B4, 125},
    {NOTE_C5, 375},
    {NOTE_B4, 125},
    {NOTE_C5, 500},
    {NOTE_G4, 500},
    {NOTE_A4, 500},
    {NOTE_C5, 375},
    {NOTE_DS5, 125},
    {NOTE_D5, 375},
    {NOTE_C5, 125},
    {NOTE_D5, 500},
    {NOTE_C5, 375},
    {NOTE_B4, 125},
    {NOTE_C5, 375},
    {NOTE_B4, 125},
    {NOTE_C5, 500},
    {NOTE_DS5, 375},
    {NOTE_D5, 500},
    {NOTE_G5, 125},
    {NOTE_REST, 375},
    {NOTE_FS5, 125},
    {NOTE_G5, 500},
    {NOTE_REST, 500},
    {NOTE_E4, 375},
    {NOTE_DS4, 125},
    {NOTE_E4, 375},
    {NOTE_DS4, 125},
    {NOTE_E4, 500},
    {NOTE_G4, 375},
    {NOTE_F4, 500},
    {NOTE_F5, 125},
    {NOTE_REST, 375},
    {NOTE_E5, 125},
    {NOTE_F5, 500},
    {NOTE_REST, 500},
    {NOTE_CS4, 375},
    {NOTE_C4, 125},
    {NOTE_F4, 375},
    {NOTE_C4, 125},
    {NOTE_AS3, 500},
    {NOTE_DS4, 375},
    {NOTE_CS4, 500},
    {NOTE_AS3, 125},
    {NOTE_REST, 375},
    {NOTE_CS5, 125},
    {NOTE_REST, 500},
    {NOTE_AS4, 375},
    {NOTE_C4, 500},
    {NOTE_B3, 125},
    {NOTE_E4, 375},
    {NOTE_B3, 125},
    {NOTE_A3, 500},
    {NOTE_D4, 375},
    {NOTE_C4, 500},
    {NOTE_A3, 125},
    {NOTE_REST, 375},
    {NOTE_C5, 125},
    {NOTE_REST, 500},
    {NOTE_A4, 375},
    {NOTE_A3, 500},
    {NOTE_F3, 125},
    {NOTE_REST, 375},
    {NOTE_F3, 125},
    {NOTE_B3, 375},
    {NOTE_G3, 125},
    {NOTE_REST, 375},
    {NOTE_G3, 125},
    {NOTE_C4, 375},
    {NOTE_A3, 125},
    {NOTE_REST, 375},
    {NOTE_D4, 125},
    {NOTE_REST, 1000},
    {NOTE_G3, 500},
    {NOTE_D4, 1000},
    {NOTE_REST, 500},
    {NOTE_D4, 500},
    {NOTE_C4, 1000},
    {NOTE_REST, 500},
    {NOTE_C4, 500},
    {NOTE_B3, 1000},
    {NOTE_REST, 500},
    {NOTE_B3, 500},
    {NOTE_C4, 1000},
    {NOTE_REST, 500},
    {NOTE_C4, 500},
    {NOTE_B3, 1000},
    {NOTE_REST, 500},
    {NOTE_C4, 1500},
    {NOTE_REST, 500},
    {NOTE_C4, 500},
    {NOTE_B3, 1000},
    {NOTE_REST, 500},
    {NOTE_C4, 1500},
    {NOTE_REST, 500},
    {NOTE_C4, 500},
    {NOTE_B3, 1000},
    {NOTE_REST, 500},
    {NOTE_C4, 1500},
    {NOTE_REST, 8500},
